## boards/samyf/vlad/Kconfig
```kconfig
# Copyright (c) 2024 Samy Francelet
# SPDX-License-Identifier: Apache-2.0

if !MCUBOOT
config BOARD_VLAD_PMIC_STARTUP
	bool "Startup code for the onboard nPM1300 PMIC"
	default y
endif # !MCUBOOT
```

## boards/samyf/vlad/Kconfig.vlad
```kconfig
# Copyright (c) 2024 Samy Francelet
# SPDX-License-Identifier: Apache-2.0

config BOARD_VLAD
	select SOC_NRF9151_LACA

if !MCUBOOT
config BOARD_VLAD_PMIC_STARTUP
	bool "Startup code for the onboard nPM1300 PMIC"
	default y
endif # !MCUBOOT
```

## boards/samyf/vlad/board.yml
```yaml
board:
  name: vlad
  vendor: samyf
  socs:
    - name: nrf9151
      variants:
        - name: ns
  revision:
    format: major.minor.patch
    default: 1.0.0
    exact: true
    revisions:
      - name: 1.0.0
```
